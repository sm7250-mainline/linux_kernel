## Documentation/devicetree/bindings/soc/qcom/qcom,adsp-sensor-pd.yaml
```yaml
# SPDX-License-Identifier: (GPL-2.0-only OR BSD-2-Clause)
%YAML 1.2
---
$id: http://devicetree.org/schemas/soc/qcom/qcom,adsp-sensor-pd.yaml#
$schema: http://devicetree.org/meta-schemas/core.yaml#

title: Qualcomm ADSP sensor protection-domain keepalive

maintainers:
  - Picasso mainline bring-up project

description: |
  Register a PDR listener for tms/servreg at msm/adsp/sensor_pd. This keeps
  the sensor protection-domain state indication acknowledged on platforms whose
  ADSP image starts sensor_process before Linux has a sensor client.

properties:
  compatible:
    const: qcom,adsp-sensor-pd

  nvmem-cells:
    maxItems: 1
    description: ADSP image variant fuse, used for diagnostics.

  nvmem-cell-names:
    items:
      - const: adsp_variant

required:
  - compatible

additionalProperties: false

examples:
  - |
    adsp-sensor-pd {
      compatible = "qcom,adsp-sensor-pd";
      nvmem-cells = <&adsp_variant>;
      nvmem-cell-names = "adsp_variant";
    };
...
```

## Documentation/devicetree/bindings/soc/qcom/qcom,smp2p-sleepstate.yaml
```yaml
# SPDX-License-Identifier: GPL-2.0-only OR BSD-2-Clause
%YAML 1.2
---
$id: http://devicetree.org/schemas/soc/qcom/qcom,smp2p-sleepstate.yaml#
$schema: http://devicetree.org/meta-schemas/core.yaml#

title: Qualcomm SMP2P sleep-state client

maintainers:
  - Andy Gross <agross@kernel.org>

description:
  Client for an SMP2P entry that advertises whether the apps processor is awake
  to a remote processor.  The remote-side state changes are delivered through a
  second SMP2P interrupt entry.

properties:
  compatible:
    const: qcom,smp2p-sleepstate

  qcom,smem-states:
    maxItems: 1
    description:
      Outgoing apps-awake SMP2P state.

  interrupts:
    maxItems: 1
    description:
      Remote sleep-state notification IRQ from the inbound SMP2P entry.

  interrupt-names:
    const: smp2p-sleepstate-in

required:
  - compatible
  - qcom,smem-states
  - interrupts
  - interrupt-names

additionalProperties: false

examples:
  - |
    smp2p-sleepstate {
        compatible = "qcom,smp2p-sleepstate";
        qcom,smem-states = <&sleepstate_smp2p_out 0>;
        interrupt-parent = <&sleepstate_smp2p_in>;
        interrupts = <0 0>;
        interrupt-names = "smp2p-sleepstate-in";
    };
...
```

## drivers/input/touchscreen/novatek-nt36672c/Kconfig
```kconfig
# SPDX-License-Identifier: GPL-2.0-only
#
# Novatek NT36672C touchscreen driver (自小米 picasso Android R 4.19 下游移植)
#

config TOUCHSCREEN_NT36672C
	tristate "Novatek NT36672C touchscreen (Xiaomi picasso, SPI)"
	depends on SPI && SPI_MASTER && OF
	help
	  Say Y here to enable support for the Novatek NT36672C touchscreen
	  as found on Xiaomi Redmi K30 5G (picasso / SM7250). The panel is a
	  TDDI part speaking SPI (standard spi_driver, DT node on the SPI bus).

	  This is a bring-up port of the Xiaomi downstream driver; suspend
	  notifications are not wired (no fb notifier events in current
	  kernels) and the panel lockdown info is fixed up from a captured
	  device (see the header comment in nt36xxx.c).

	  If unsure, say N.
```
